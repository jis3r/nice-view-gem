## boards/shields/nice_view_gem_preview/Kconfig.shield
```kconfig
config SHIELD_NICE_VIEW_GEM_PREVIEW
    def_bool $(shields_list_contains,nice_view_gem_preview)

if SHIELD_NICE_VIEW_GEM_PREVIEW

config NICE_VIEW_GEM_PREVIEW
    bool
    default y

endif # SHIELD_NICE_VIEW_GEM_PREVIEW
```

## dts/bindings/behaviors/nice-view-gem,behavior-claude-stats.yaml
```yaml
# Copyright (c) 2026
# SPDX-License-Identifier: MIT

description: Claude usage stats split-relay behavior

compatible: "nice-view-gem,behavior-claude-stats"

include: two_param.yaml
```
